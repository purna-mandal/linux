## Documentation/devicetree/bindings/dma/microchip,pic32-dma.txt
```
* PIC32 DMA Controller

The PIC32 DMA controller has 8 channels in total.
Each DMA channel is capable of
 - memory-to-device, device-to-memory and memory-to-memory transfer.
 - Automatic flow-control & abort based on peripheral interrupt sources.
 - One-Shot or Auto-Repeat Block Transfer.

Required properties:
- compatible: Should be "microchip,pic32mzda-dma".
- reg: Should contain DMA registers location and length.
- interrupts: Should contain the DMA interrupts associated
		to the DMA channels in ascending order.
Example:

	dma: dma-controller@1f811000 {
		compatible = "microchip,pic32mzda-dma";
		reg = <0x1f811000 0x2000>;
		interrupts = <134 IRQ_TYPE_EDGE_RISING>,
			<135 IRQ_TYPE_EDGE_RISING>,
			<136 IRQ_TYPE_EDGE_RISING>,
			<137 IRQ_TYPE_EDGE_RISING>,
			<138 IRQ_TYPE_EDGE_RISING>,
			<139 IRQ_TYPE_EDGE_RISING>,
			<140 IRQ_TYPE_EDGE_RISING>,
			<141 IRQ_TYPE_EDGE_RISING>;
		#dma-cells = <1>;
	};

DMA clients connected to the PIC32 DMA controller must use the format
described in the dma.txt file, using a two-cell specifier for each channel.

Each dma request consists of 2 cells:
 1. phandle pointing to the DMA controller
 2. DMA channel number.

Example:

	i2s1: i2s@1f821000 {
		compatible = "microchip,pic32mzda-i2s";
		reg = <0x1f821000 0x200>;
		interrupts = <110 IRQ_TYPE_LEVEL_HIGH>,
			<111 IRQ_TYPE_LEVEL_HIGH>;
		dmas = <&dma 134>,
			<&dma 135>;
		dma-names = "rx", "tx";
		clocks = <&PBCLK2>, <&REFCLKO1>;
		clock-names = "mck0","mck1";
	};
```

## Documentation/devicetree/bindings/dma/pic32-dma.txt
```
* PIC32 DMA contorller driver

The PIC32 DMA controller has 8 channels in total.
Only the lower 13 channels have an associated IRQ.
Some arbitrary channels are used by the firmware
(1,3,6,7 in the current firmware version).
The channels 0,2 and 3 have special functionality
and should not be used by the driver.

Required properties:
- compatible: Should be "microchip,pic32-dma".
- reg: Should contain DMA registers location and length.
- interrupts: Should contain the DMA interrupts associated
		to the DMA channels in ascending order.

Example:

	dma0: dma@bf811000 {
		compatible = "microchip,pic32-dma";
		reg = <0xbf811000 0x2000>;
		interrupts = <DMA_CHANNEL_0 DEFAULT_INT_PRI IRQ_TYPE_NONE>,
			<DMA_CHANNEL_1 DEFAULT_INT_PRI IRQ_TYPE_NONE>,
		       <DMA_CHANNEL_2 DEFAULT_INT_PRI IRQ_TYPE_NONE>,
		       <DMA_CHANNEL_3 DEFAULT_INT_PRI IRQ_TYPE_NONE>,
		       <DMA_CHANNEL_4 DEFAULT_INT_PRI IRQ_TYPE_NONE>,
		       <DMA_CHANNEL_5 DEFAULT_INT_PRI IRQ_TYPE_NONE>,
		       <DMA_CHANNEL_6 DEFAULT_INT_PRI IRQ_TYPE_NONE>,
		       <DMA_CHANNEL_7 DEFAULT_INT_PRI IRQ_TYPE_NONE>;
	};

DMA clients connected to the PIC32 DMA controller must use the format
described in the dma.txt file, using a two-cell specifier for each channel.

Example:

	i2s5: i2s@bf821A00 {
		compatible = "microchip,pic32-i2s";
		reg = <0xbf821A00 512>;
		interrupts = <SPI6_RECEIVE_DONE DEFAULT_INT_PRI IRQ_TYPE_NONE>,
			<SPI6_TRANSFER_DONE DEFAULT_INT_PRI IRQ_TYPE_NONE>;
		dmas = <&dma 6>,
			<&dma0 7>;
		dma-names = "rx", "tx";
		clocks = <&PBCLK2>;
       };
```

## Documentation/devicetree/bindings/net/microchip,pic32-ec.txt
```
* PIC32 Ethernet Controller

Required properties:
- compatible: Should be "microchip,pic32mzda-ec"
- reg: Address and length of the register-set (and optional,
       coherent-memory-region) for the device.
- reg-name: name of above "reg" property name. It must have "regs". Add
	    "mem" if optional coherent-memory-region is available.
- interrupts: Should contain ethernet interrupt
- phy-mode: See ethernet.txt file in the same directory.
- clock-names: Single clock names.
	Required elements: 'eth_clk'
- clocks: Phandle to clock.

Optional properties:
- local-mac-address: Static MAC address.

Examples:

	pic32_ether: ethernet@1f882000 {
		compatible = "microchip,pic32mzda-ec";
		reg = <0x1f882000 0x1000>,<0x1000 0x7f000>;
		reg-name= "regs","mem";
		interrupts = <153 IRQ_TYPE_LEVEL_HIGH>;
		phy-mode = "rmii";
		local-mac-address = [00 00 00 00 00 00];
		clock-names = "eth_clk";
		clocks = <&PBCLK5>;
	};
```

## Documentation/devicetree/bindings/net/pic32_ether.txt
```
* PIC32 Ethernet Controller

Required properties:
- compatible: Should be "microchip,pic32-ether"
- reg: Address and length of the register set for the device
- interrupts: Should contain ethernet interrupt
- phy-mode: See ethernet.txt file in the same directory.
- clock-names: Single clock names.
	Required elements: 'eth_clk'
- clocks: Phandle to clock.

Examples:

	pic32_ether: ethernet@bf882000 {
		compatible = "microchip,pic32-ether";
		reg = <0xbf882000 0x1000>;
		interrupts = <ETHERNET_INTERRUPT DEFAULT_INT_PRI IRQ_TYPE_LEVEL_HIGH>;
		phy-mode = "rmii";
		mac-address = [00 00 00 00 00 00];
		clock-names = "eth_clk";
		clocks = <&PBCLK5>;
	};
```

## Documentation/devicetree/bindings/serial/microchip,pic32-usart.txt
```
* Microchip Universal Synchronous Asynchronous Receiver/Transmitter (USART)

Required properties:
- compatible: Should be "microchip,pic32-usart"
- reg: Should contain registers location and length
- interrupts: Should contain interrupt
- pinctrl: Should contain pinctrol for TX/RX/RTS/CTS
- gpios: Should contain gpio pins for CTS/RTS

Example:
	usart0: serial@bf822000 {
		compatible = "microchip,pic32-usart";
		reg = <0xbf822000 0x50>;
		interrupts = <UART1_FAULT DEFAULT_INT_PRI IRQ_TYPE_NONE>,
			     <UART1_RECEIVE_DONE DEFAULT_INT_PRI IRQ_TYPE_NONE>,
			     <UART1_TRANSFER_DONE DEFAULT_INT_PRI IRQ_TYPE_NONE>;
		pinctrl-names = "default";
		pinctrl-0 = <
			&pinctrl_uart1
			&pinctrl_uart1_cts
			&pinctrl_uart1_rts>;
		/* CTS/RTS */
		cts-gpios = <&pioB 15 0>;
		rts-gpios = <&pioD 1 0>;
	};
```

## Documentation/devicetree/bindings/sound/microchip,pic32-i2s.txt
```
PIC32 SoC I2S Driver

Required properties:
- compatible : "microchip,pic32mzda-i2s"
- reg : Should contain I2S registers location (physical address) and length
- interrupts : Should contain I2S receive and transmit interrupts
- dmas : Must contain an entry for each entry in clock-names.
  See ../dma/dma.txt for details.
- dma-names : Must include the following entries:
  - rx
  - tx
- clocks : Must contain one entry, for the module clock.
  See ../clocks/clock-bindings.txt for details.

Example:

	i2s0: i2s@1f821000 {
		compatible = "microchip,pic32mzda-i2s";
		reg = <0x1f821000 512>;
		interrupts = <110 IRQ_TYPE_NONE>,
			<111 IRQ_TYPE_NONE>;
		dmas = <&dma 0>,
			<&dma 1>;
		dma-names = "rx", "tx";
		clocks = <&PBCLK2>;
	};
```

## Documentation/devicetree/bindings/timer/mchp,pic32-ocmp.txt
```
Microchip PIC32 output-compare

The PIC32 output-compare(OC) module can generate single pulse or train of pulses
in response to selected time bases and operating mode. This module is capable of
triggering ADC or asserting interrupt and working as PWM controller.

Required properties:
- compatible : should be "mchp,pic32-ocmp".
- reg : Specifies base address and size of the registers.
- interrupts : See evic ../interrupt-controller/.
- oc-id: module id (starting at 1) as documented in FRM.

Optional properties:
- mchp,oc-32bit : added only when 32bit timebase is used.
- mchp,oc-adc : OC can trigger an ADC.
- mchp,oc-pwm: OC as PWM controller.

Example:

ocmp1: {
	#oc-cells = <0>;
	compatible = "mchp,pic32-ocmp";
	reg = <0xbf844000 0x30>;
	interrupts = <0>;
	oc-id = <1>;
	mchp,oc-32bit; /* class B, 32-bit combined timer; usable for ADC */
	mchp,oc-pwm; /* PWM controller */
};

The output-compare consumers should specify the desire OC by having in its
"pic32,ocmp" phandle cell. For example for PWM

pwm-0: {
	compatible = <>;
	mchp,ocmp = <&ocmp1>; /* ocmp phandle */
};
```

## Documentation/devicetree/bindings/timer/mchp,pic32-pb-timer.txt
```
Microchip PIC32 general purpose timer

The PIC32 timer module provides one class-A 16-bit timer and eight 16-bit class-B free
running counter. Two consecutive 16-bit timers can be combined to form one
32-bit timer.

Required properties:

- compatible : should be one of the followings
	"mchp,pic32-timer"      16-bit class-B timer.
	"mchp,pic32-timerA"	16-bit class-A timer
	"mchp,pic32-timer32"	32-bit class-B timer
	"mchp,pic32-timer-adc"	16-bit ADC event trigger timer.
- reg : Specifies base address and size of the registers.
- interrupts : See evic ../interrupt-controller/.
- clocks : Must contain one entry, for the module clock.
  See ../clocks/clock-bindings.txt for details.
- timer-id: timer id (starting at 1) as documented in FRM.

Optional properties:
- mchp,timer-A : added only for class-A timer.
- mchp,timer-async : asynchronous clock source.
- mchp,timer-32bit : timer support 32bit counting.
- mchp,timer-gated : gated timer
- mchp,timer-adc : timer can trigger an ADC.
- mchp,timer-oneshot: one-shot timer, instead of continuous.
- clock-frequency : default timer rate, see ../clocks/clock-bindings.txt for details.
- mchp,clock-indices: See ../clocks/mchp,pic32-clock.txt


Example:

pbtimer4:pbtimer4 {
	#timer-cells = <0>;
	compatible = "mchp,pic32-timer";
	reg = <0xbf840600 0x400>;
	interrupts = <0>;
	clocks = <&PBCLK3>, <&TxCKI>;
	timer-id = <4>;
	mchp,timer-32bit; /* class B, 32-bit combined timer; usable for ADC */
	mchp,timer-adc;
	clock-frequency = <200000000>; /* 200MHZ */
};

The timer consumers should specify the desire timer by having the timer in its
"pic32,timer" phandle cell. For example for PWM

pwm-0: {
	compatible = <>;
	mchp,timer = <&pbtimer4>; /* pbtimer phandle */
};
```

## Documentation/devicetree/bindings/usb/microchip,pic32-musb.txt
```
Microchip PIC32 MUSB DRC/OTG controller
-------------------------------------------

Required properties:
 - compatible       : should be "microchip,pic32mzda-usb".
 - reg              : offset and length of "MUSB Core Registers" and
		      "USB Clock & Reset Registers".
 - reg-names        : should be "mc", and "usbcr" in order
 - clocks           : clock specifier for the musb controller clock
 - interrupts       : interrupt number for MUSB Core General interrupt
		      and DMA interrupt
 - interrupt-names  : must be "mc" and "dma" in order.
 - dr_mode          : should be one of "host", "peripheral" or "otg".
 - microchip,power  : should be "500". This signifies the controller can supply
		      up to 500mA when operating in host mode.
 - usb-phy          : phandle of the USB PHY.
 - usb-overcurrent  : phandle of MUSB over-current node. It should have
		      interrupt number for over-current detection logic.

Optional properties:
 - microchip,fifo-mode: specifies layout of internal SRAM for end-point fifos.
			Defaults 0.

Example:
	aliases {
		usb1 = &usb1;
		phy1 = &usb1_phy;
	};

	usb1: usb@1f8e3000 {
		compatible = "microchip,pic32mzda-usb";
		reg = <0x1f8e3000 0x1000>,
		      <0x1f884000 0x1000>;
		reg-names = "mc", "usbcr";
		interrupts = <132 IRQ_TYPE_EDGE_RISING>,
			     <133 IRQ_TYPE_LEVEL_HIGH>;
		interrupt-names = "mc", "dma";
		clocks = <&rootclk PB5CLK>;
		dr_mode = "host";
		microchip,power = <500>;
		usb-phy = <&usb1_phy>;
		usb-overcurrent = <&usb1_overcurrent>;
	};

	usb1_phy: usb-phy@1f8e4000 {
		compatible = "usb-nop-xceiv";
		reg = <0x1f8e4000 0x1000>;
		clocks = <&rootclk UPLLCLK>;
		clock-names = "main_clk";
		clock-frequency = <24000000>;
	};

	usb1_overcurrent: usb-overcurrent@0 {
		interrupt-parent = <&gpio1>;
		interrupts = <11 IRQ_TYPE_EDGE_FALLING>;
	};
```

## Documentation/devicetree/bindings/watchdog/pic32-wdt.txt
```
* PIC32 Watchdog Timer

** pic32-wdt

Required properties:
- compatible: must be "microchip,pic32-wdt".
- reg: physical base address of the controller and length of memory mapped
  region.
- clocks: phandle of source clk. should be <&LPRC> clk.

Example:

	watchdog: wdt@bf800800 {
		compatible = "microchip,pic32-wdt";
		reg = <0xbf800800 0x200>;
		clocks = <&LPRC>;
	};
```

## arch/mips/pic32/Kconfig
```kconfig
if MACH_PIC32

choice
	prompt "Machine Type"

config MIPS_PIC32MZ
	bool "PIC32MZ Starter Kit"
	select PIC32
	select BOOT_ELF32
	select BOOT_RAW
	select CEVT_R4K
	select CSRC_R4K
	select DMA_NONCOHERENT
	select IRQ_CPU
	select SYS_HAS_CPU_MIPS32_R2
	select SYS_HAS_CPU_NEVADA
	select SYS_HAS_EARLY_PRINTK
	select SYS_SUPPORTS_32BIT_KERNEL
	select SYS_SUPPORTS_LITTLE_ENDIAN
	select ARCH_SPARSEMEM_ENABLE
	select ARCH_REQUIRE_GPIOLIB
	select HAVE_MACH_CLKDEV
	select HAVE_MACH
	select COMMON_CLK
	select CLKDEV_LOOKUP
	select LIBFDT
	select USE_OF
	select PINCTRL
	select PINCTRL_PIC32
	select PINCTRL_PIC32MZ
	select SERIAL_PIC32
	select BUILTIN_DTB
	help
	  Microchip PIC32MZ Starter Kit.

	  A starter kit and Plan B development board combo that adds additional
	  SRAM over the EBI interface.

config MIPS_PIC32_EPLATFORM
	bool "PIC32 ePlatform"
	select PIC32
	select BOOT_ELF32
	select BOOT_RAW
	select CEVT_R4K
	select CSRC_R4K
	select DMA_NONCOHERENT
	select IRQ_CPU
	select SYS_HAS_CPU_MIPS32_R2
	select SYS_HAS_CPU_NEVADA
	select SYS_HAS_EARLY_PRINTK
	select SYS_SUPPORTS_32BIT_KERNEL
	select SYS_SUPPORTS_LITTLE_ENDIAN
	select ARCH_REQUIRE_GPIOLIB
	select HAVE_MACH_CLKDEV
	select HAVE_MACH
	select COMMON_CLK
	select CLKDEV_LOOKUP
	select LIBFDT
	select USE_OF
	select PINCTRL
	select PINCTRL_PIC32
	select PINCTRL_PIC32MZ
	select SERIAL_PIC32
	select BUILTIN_DTB
	help
	  Microchip PIC32 ePlatform.

	  An in-house simulation platform for development of future generations
	  of PIC32 platforms.

endchoice

config PIC32
	bool

config PIC32MZ_UPPER_MEMORY
	bool "Enable PIC32MZ Upper Memory Support"
	depends on MIPS_PIC32MZ
	help
	  PIC32MZ support for running XIP with more available SRAM over EBI in
	  KSEG2/KSEG3.

config PIC32MZ_ZBOOT
	bool "Enable PIC32MZ ZBOOT"
	depends on !PIC32MZ_UPPER_MEMORY && MIPS_PIC32MZ
	select SYS_SUPPORTS_ZBOOT
	select CONFIG_MAPPED_KERNEL
	help
	  PIC32MZ support for zboot which provides a decompressor to run XIP
	  from internal flash and run the kernel from mapped memory in
	  KSEG2/KSEG3.

choice
	prompt "PIC32MZ Daughter Card Type"
	depends on PIC32MZ_ZBOOT || PIC32MZ_UPPER_MEMORY

config PIC32MZ_PLANB
	bool "PIC32MZ With Plan B Board"
	help
	  PIC32MZ With Plan B Board

config PIC32MZ_PLANC
	bool "PIC32MZ With Plan C Board"
	help
	  PIC32MZ With Plan C Board

endchoice

endif # MACH_PIC32
```
