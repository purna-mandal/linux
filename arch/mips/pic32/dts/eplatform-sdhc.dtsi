/ {
	/* AHB:   base virtual address: 0xbf8e_     : _ffff
	 * SDIOC: base virtual address:       _c000 : _cfff
	 * ! Bus matrix - AHB address range.
	 */
	sdhci@bf8ec000 {
		compatible = "microchip,sdhci-eplatform";
		reg = <0xbf8ec000 0x100>;
		interrupts = <SDHC_EVENT DEFAULT_INT_PRI IRQ_TYPE_LEVEL_HIGH>;
	};
};
