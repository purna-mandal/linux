
/ {
	aliases {
		serial0 = &usart0;
		serial1 = &usart1;
	};

	usart0: serial@bf822000 {
		compatible = "microchip,pic32-usart";
		reg = <0xbf822000 0x50>;
		interrupts = <UART1_FAULT DEFAULT_INT_PRI IRQ_TYPE_LEVEL_HIGH>,
			     <UART1_RECEIVE_DONE DEFAULT_INT_PRI IRQ_TYPE_LEVEL_HIGH>,
			     <UART1_TRANSFER_DONE DEFAULT_INT_PRI IRQ_TYPE_LEVEL_HIGH>;
		clocks = <&PBCLK2>;
		pinctrl-names = "default";
		pinctrl-0 = <
			&pinctrl_uart1
			&pinctrl_uart1_cts
			&pinctrl_uart1_rts>;
		cts-gpios = <&pioB 15 0>;
		rts-gpios = <&pioD 1 0>;
	};

	usart1: serial@bf822200 {
		compatible = "microchip,pic32-usart";
		reg = <0xbf822200 0x50>;
		interrupts = <UART2_FAULT DEFAULT_INT_PRI IRQ_TYPE_LEVEL_HIGH>,
			     <UART2_RECEIVE_DONE DEFAULT_INT_PRI IRQ_TYPE_LEVEL_HIGH>,
			     <UART2_TRANSFER_DONE DEFAULT_INT_PRI IRQ_TYPE_LEVEL_HIGH>;
		clocks = <&PBCLK2>;
		pinctrl-names = "default";
		pinctrl-0 = <
			&pinctrl_uart2
			&pinctrl_uart2_cts
			&pinctrl_uart2_rts>;
		cts-gpios = <&pioB 10 0>;
		rts-gpios = <&pioD 7 0>;
	};
};
