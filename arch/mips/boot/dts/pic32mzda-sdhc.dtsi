/ {
	/* AHB:   base virtual address: 0xbf8e_0000 : _ffff
	 * SDIOC: base virtual address:       _c000 : _cfff
	 * ! Bus matrix - AHB address range.
	 */
	sdhci@bf8ec000 {
		compatible = "microchip,pic32-sdhci";
		reg = <0xbf8ec000 0x100>;
		interrupts = <SDHC_EVENT DEFAULT_INT_PRI IRQ_TYPE_LEVEL_HIGH>;
		/* TODO?: bus width and Shared Bus configs. */
		/* change to SDHCLK */
		clocks = <&REFCLKO4>;
	};
};
